## conf/bblayers.conf
```bitbake
LCONF_VERSION = "6"

BBPATH = "${TOPDIR}"
BBFILES ?= ""

LAYDIR = "${TOPDIR}/.."
BBLAYERS ?= " \
  ${LAYDIR}/poky/meta \
  ${LAYDIR}/poky/meta-yocto \
  ${LAYDIR}/poky/meta-yocto-bsp \
  ${LAYDIR}/meta-openembedded/meta-oe \
  ${LAYDIR}/meta-openembedded/meta-python \
  ${LAYDIR}/meta-openembedded/meta-networking \
  ${LAYDIR}/meta-fsl-arm \
  ${LAYDIR}/meta-fsl-arm-extra \
  ${LAYDIR}/xbterminal-yocto/meta-xbterminal \
  "
BBLAYERS_NON_REMOVABLE ?= " \
  ${LAYDIR}/poky/meta \
  ${LAYDIR}/poky/meta-yocto \
  "
```

## conf/local.conf
```bitbake
MACHINE ?= "qemuarm"
DISTRO ?= "poky"
PACKAGE_CLASSES ?= "package_deb"

# https://www.yoctoproject.org/docs/current/ref-manual/ref-manual.html#var-EXTRA_IMAGE_FEATURES
EXTRA_IMAGE_FEATURES = "debug-tweaks"

#   - 'buildstats' collect build statistics
#   - 'image-mklibs' to reduce shared library files size for an image
#   - 'image-prelink' in order to prelink the filesystem image
USER_CLASSES ?= "buildstats image-mklibs image-prelink"

PATCHRESOLVE = "noop"

BB_DISKMON_DIRS = "\
    STOPTASKS,${TMPDIR},1G,100K \
    STOPTASKS,${DL_DIR},1G,100K \
    STOPTASKS,${SSTATE_DIR},1G,100K \
    ABORT,${TMPDIR},100M,1K \
    ABORT,${DL_DIR},100M,1K \
    ABORT,${SSTATE_DIR},100M,1K" 

PACKAGECONFIG_append_pn-qemu-native = " sdl"
PACKAGECONFIG_append_pn-nativesdk-qemu = " sdl"
ASSUME_PROVIDED += "libsdl-native"

CONF_VERSION = "1"

PREFERRED_PROVIDER_jpeg = "jpeg"
PREFERRED_PROVIDER_jpeg-native = "jpeg-native"
```

## meta-xbterminal/conf/distro/poky-xbt.conf
```bitbake
require conf/distro/poky.conf

DISTRO = "poky-xbt"

DISTRO_FEATURES_append = " systemd"
VIRTUAL-RUNTIME_init_manager = "systemd"
VIRTUAL-RUNTIME_initscripts = ""

DISTRO_FEATURES_BACKFILL_CONSIDERED = "sysvinit pulseaudio bluez5"

PREFERRED_PROVIDER_jpeg = "jpeg"
PREFERRED_PROVIDER_jpeg-native = "jpeg-native"

PREFERRED_VERSION_salt-minion ?= "2015.8.3"
PREFERRED_VERSION_salt-common ?= "2015.8.3"
PREFERRED_VERSION_salt ?= "2015.8.3"

PREFERRED_VERSION_xbterminal_rpc = "${@d.getVar('XBT_PV', True) or ''}"
PREFERRED_VERSION_xbterminal_gui = "${@d.getVar('XBT_PV', True) or ''}"

# https://lists.yoctoproject.org/pipermail/meta-freescale/2014-August/010222.html
PREFERRED_VERSION_xserver-nodm-init = "1.0"

PREFERRED_VERSION_syslog-ng =  "3.6.4"
```

## meta-xbterminal/conf/layer.conf
```bitbake
# We have a conf and classes directory, add to BBPATH
BBPATH .= ":${LAYERDIR}"

# We have recipes-* directories, add to BBFILES
BBFILES += "${LAYERDIR}/images/*.bb \
            ${LAYERDIR}/recipes-*/*/*.bb \
            ${LAYERDIR}/recipes-*/*/*.bbappend"

BBFILE_COLLECTIONS += "meta-xbterminal"
BBFILE_PATTERN_meta-xbterminal = "^${LAYERDIR}/"

# meta-python layer has priority 7
BBFILE_PRIORITY_meta-xbterminal = "8"

LAYERDEPENDS_meta-xbterminal = "\
    core \
    openembedded-layer \
    networking-layer \
    fsl-arm \
    fsl-arm-extra \
    "
```

## meta-xbterminal/conf/machine/imx6ulevk-itl.conf
```bitbake
#@TYPE: Machine
#@NAME: Freescale i.MX6UL ITL edition
#@SOC: i.MX6UL
#@DESCRIPTION: Machine configuration for Freescale i.MX6UL EVK

require conf/machine/imx6ulevk.conf

KERNEL_DEVICETREE = "imx6ul-itl-apm.dtb"

UBOOT_CONFIG[sd] = "mx6ul_itl_apm_config,sdcard"
```
